AUTOSAR XML (schema 00050)
package /sentil/interfaces
  service interface SignalInterface
    namespaces:
      symbol props sentil
    events:
      data SignalFrame: type=SignalFrame
package /sentil/types
  impl type SignalFrame: category=STRUCTURE
    element t: category=VALUE, base-type=Float64
    element names: category=VECTOR, type=StringVector
    element values: category=VECTOR, type=Float64Vector
