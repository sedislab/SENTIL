AUTOSAR XML (schema 00050)
package /sentil/interfaces
  service interface ControlInterface
    field ControllerStatus: type=ControllerStatus, has-getter=true, has-notifier=true, has-setter=false
    events:
      data ControlCommand: type=Float64Vector
    methods:
      operation ComputeControl
        4 x arg:
          state: type=Float64Vector, direction=IN
          nominal: type=Float64Vector, direction=IN
          command: type=Float64Vector, direction=OUT
          feasible: type=Boolean, direction=OUT
package /sentil/types
  impl type ControllerStatus: category=STRUCTURE
    4 x element, all with category=VALUE:
      deadline_met
      feasible
      cbf_active
      robustness
