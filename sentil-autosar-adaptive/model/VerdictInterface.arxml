AUTOSAR XML (schema 00050)
package /sentil/interfaces
  service interface VerdictInterface
    field Verdict: type=Verdict, has-getter=true, has-notifier=true, has-setter=false
    events:
      data Violation: type=Verdict
    methods:
      operation SetSpecification
        arg formula: type=String, direction=IN
        arg accepted: type=Boolean, direction=OUT
package /sentil/types
  impl type Verdict: category=STRUCTURE
    8 x element, all with category=VALUE:
      timestamp
      robustness_min
      robustness_max
      satisfied
      is_concrete
      probability
      ci_lower
      ci_upper
